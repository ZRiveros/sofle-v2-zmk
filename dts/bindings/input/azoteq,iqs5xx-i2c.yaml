## dts/bindings/input/azoteq,iqs5xx-i2c.yaml
```yaml
description: |
  Sensor driver for Azoteq IQS5XX trackpads, using the I2C interface.
  Supports both interrupt-driven mode (with RDY pin) and polling mode (without RDY pin).

compatible: "azoteq,iqs5xx"

include: ["i2c-device.yaml", "azoteq,iqs5xx-common.yaml"]
```
