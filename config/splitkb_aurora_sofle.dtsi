/*
 * Copyright (c) 2025 The ZMK Contributors
 * SPDX-License-Identifier: MIT
 * 
 * Aurora Sofle OLED and RGB Configuration Override
 */

/ {
    chosen {
        zmk,underglow = &led_strip;
    };
};

&oled {
    status = "okay";
};

&led_strip {
    status = "okay";
    chain-length = <35>; // 29 per-key + 6 underglow (3 per side)
};
